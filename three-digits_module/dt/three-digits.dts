/dts-v1/;
/plugin/;

#include "gpios_three_digits.h"

#include <dt-bindings/pinctrl/bcm2835.h>
#include <dt-bindings/gpio/gpio.h>

/{
    compatible = "brcm,bcm2835";

    fragment@0 {
        target = <&gpio>;
        __overlay__ {
            three_digits_pins: three-digits-pins@0 {
                brcm,pins = <GPIO_DIGIT_1_POWER
                             GPIO_DIGIT_2_POWER
                             GPIO_DIGIT_3_POWER
                             GPIO_SEG_A
                             GPIO_SEG_B
                             GPIO_SEG_C
                             GPIO_SEG_D
                             GPIO_SEG_E
                             GPIO_SEG_F
                             GPIO_SEG_G
                             GPIO_DOT>;
                brcm,function = <BCM2835_FSEL_GPIO_OUT>;
                brcm,pull = <BCM2835_PUD_UP>;
            };
        };
    };

    fragment@1 {
        target-path = "/";
        __overlay__ {
            three_digits: three-digits@0 {
                compatible = "three-digits";
                pinctrl-names = "default";
                pinctrl-0 = <&three_digits_pins>;
                power-gpios = <&gpio GPIO_DIGIT_1_POWER  GPIO_ACTIVE_HIGH>,
                              <&gpio GPIO_DIGIT_2_POWER  GPIO_ACTIVE_HIGH>,
                              <&gpio GPIO_DIGIT_3_POWER  GPIO_ACTIVE_HIGH>;
                led-gpios =   <&gpio GPIO_SEG_A          GPIO_ACTIVE_HIGH>,
                              <&gpio GPIO_SEG_B          GPIO_ACTIVE_HIGH>,
                              <&gpio GPIO_SEG_C          GPIO_ACTIVE_HIGH>,
                              <&gpio GPIO_SEG_D          GPIO_ACTIVE_HIGH>,
                              <&gpio GPIO_SEG_E          GPIO_ACTIVE_HIGH>,
                              <&gpio GPIO_SEG_F          GPIO_ACTIVE_HIGH>,
                              <&gpio GPIO_SEG_G          GPIO_ACTIVE_HIGH>,
                              <&gpio GPIO_DOT            GPIO_ACTIVE_HIGH>;
            };
        };
    };
};

